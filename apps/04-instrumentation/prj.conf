## CMakeLists.txt
```
cmake_minimum_required(VERSION 3.20.0)

# Apply our shared device tree overlay (pillar #2).
# MUST be set BEFORE find_package(Zephyr).
set(EXTRA_DTC_OVERLAY_FILE ${CMAKE_CURRENT_SOURCE_DIR}/../../boards/nucleo_f401re.overlay)

# Pull in the whole Zephyr build system (toolchain, Kconfig, device tree...).
find_package(Zephyr REQUIRED HINTS $ENV{ZEPHYR_BASE})
project(instrumentation)

# 'app' is the library target Zephyr predefines; we attach our sources to it.
target_sources(app PRIVATE src/main.c)

# Shared helpers (timing.h).
target_include_directories(app PRIVATE ${CMAKE_CURRENT_SOURCE_DIR}/../../common)
```

## prj.conf
```kconfig
# --- Console / logging subsystem ---
CONFIG_PRINTK=y
CONFIG_LOG=y
CONFIG_LOG_MODE_IMMEDIATE=y
CONFIG_THREAD_NAME=y

# --- GPIO (LED via device tree) ---
CONFIG_GPIO=y

# --- Thread analyzer: per-thread stack usage + CPU runtime ---
CONFIG_THREAD_ANALYZER=y
CONFIG_THREAD_ANALYZER_USE_PRINTK=y
CONFIG_THREAD_ANALYZER_AUTO=y
CONFIG_THREAD_ANALYZER_AUTO_INTERVAL=5

# --- Runtime stats (CPU time per thread) ---
CONFIG_THREAD_RUNTIME_STATS=y
CONFIG_SCHED_THREAD_USAGE=y
```

## src/main.c
```c
/*
 * Demo 04 - INSTRUMENTATION & visualization.
 *
 * Reuse a previous scenario, but focus on OBSERVING it:
 *   - CONFIG_THREAD_ANALYZER prints per-thread stack usage + CPU runtime.
 *   - Logging subsystem (LOG_*) emits structured timestamped events.
 *   - tools/gantt.py turns those logs into a timeline.
 *
 * GOAL: produce the data that makes the inversion VISIBLE (Gantt) and
 *       quantified (CPU time per thread).
 *
 * TODO
 *  [ ] Start your threads (e.g. the Demo 01 scenario).
 *  [ ] Emit one LOG line per scheduling event: "[<cycles>] <THREAD> <event>".
 *  [ ] Capture the serial output, feed it to tools/gantt.py.
 *  [ ] (Optional) call thread_analyzer_print() yourself instead of AUTO.
 *
 * Useful: CONFIG_THREAD_ANALYZER*, k_thread_runtime_stats_get(),
 *         LOG_MODULE_REGISTER, LOG_INF(), k_cycle_get_32().
 */

#include <zephyr/kernel.h>
#include <zephyr/logging/log.h>

LOG_MODULE_REGISTER(demo04, LOG_LEVEL_INF);

int main(void)
{
    LOG_INF("Demo 04 - instrumentation");
    /* TODO: start threads and emit structured logs here. */
    return 0;
}
```
